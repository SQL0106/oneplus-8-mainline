/dts-v1/;

/ {
	model = "Qualcomm Technologies, Inc. kona v2.1 SoC 19805";
	compatible = "qcom,kona";
	chassis-type = "handset";

	qcom,msm-id = <356 0x10000>, <356 0x20001>;
	qcom,board-id = <8 0>, <0 0>;
};
